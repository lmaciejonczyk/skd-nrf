## CMakeLists.txt
```
#
# Copyright (c) 2020 Nordic Semiconductor ASA
#
# SPDX-License-Identifier: LicenseRef-BSD-5-Clause-Nordic
#
cmake_minimum_required(VERSION 3.13.1)

set(NRF_SUPPORTED_BOARDS
	nrf52840_pca10056
)

# IMPORTANT: this must come before including boilerplate.cmake.
set(KCONFIG_ROOT ${CMAKE_CURRENT_SOURCE_DIR}/Kconfig)

include($ENV{ZEPHYR_BASE}/../nrf/cmake/boilerplate.cmake)
include($ENV{ZEPHYR_BASE}/cmake/app/boilerplate.cmake NO_POLICY_SCOPE)
project(openthread_coap_client)

FILE(GLOB app_sources src/*.c)
target_sources(app PRIVATE ${app_sources})
```

## Kconfig
```
#
# Copyright (c) 2020 Nordic Semiconductor ASA
#
# SPDX-License-Identifier: LicenseRef-BSD-5-Clause-Nordic
#

menu "Zephyr Kernel"
source "Kconfig.zephyr"
endmenu

module = COAP_CLIENT
module-str = CoAP client
source "${ZEPHYR_BASE}/subsys/logging/Kconfig.template.log_config"

module = COAP_UTILS
module-str = CoAP utils
source "${ZEPHYR_BASE}/subsys/logging/Kconfig.template.log_config"
```

## sample.yaml
```
sample:
  description: Test CoAP communication in Thread network
  name: Openthread CoAP Client
tests:
  sample.net.openthread.coap_client:
    tags: net openthread coap
    platform_whitelist: nrf52840_pca10056 nrf52833_pca10100
```

## prj.conf
```kconfig
#
# Copyright (c) 2020 Nordic Semiconductor
#
# SPDX-License-Identifier: LicenseRef-BSD-5-Clause-Nordic
#
CONFIG_NCS_SAMPLES_DEFAULTS=y

# Generic networking options
CONFIG_NETWORKING=y
CONFIG_NET_UDP=y
CONFIG_NET_IPV6=y
CONFIG_NET_SOCKETS=y
CONFIG_NET_SOCKETS_POSIX_NAMES=y
CONFIG_NET_SOCKETS_POLL_MAX=4
CONFIG_NET_CONNECTION_MANAGER=y

# Enable CoAP protocol
CONFIG_COAP=y
CONFIG_HEAP_MEM_POOL_SIZE=2048

# Kernel options
CONFIG_MAIN_STACK_SIZE=2048
CONFIG_ENTROPY_GENERATOR=y
CONFIG_INIT_STACKS=y

# Logging
CONFIG_NET_LOG=y
CONFIG_LOG=y
CONFIG_NET_STATISTICS=y
CONFIG_PRINTK=y
CONFIG_COAP_CLIENT_LOG_LEVEL_DBG=y
CONFIG_COAP_UTILS_LOG_LEVEL_DBG=y

# Network buffers
CONFIG_NET_PKT_RX_COUNT=16
CONFIG_NET_PKT_TX_COUNT=16
CONFIG_NET_BUF_RX_COUNT=80
CONFIG_NET_BUF_TX_COUNT=80
CONFIG_NET_CONTEXT_NET_PKT_POOL=y
CONFIG_NET_MAX_CONTEXTS=10

# Network shell
CONFIG_NET_SHELL=y

CONFIG_CPLUSPLUS=y

CONFIG_NET_CONFIG_SETTINGS=y
CONFIG_NET_IPV6_NBR_CACHE=n
CONFIG_NET_IPV6_MLD=n
CONFIG_NET_CONFIG_NEED_IPV6=y
CONFIG_NET_CONFIG_INIT_TIMEOUT=3

CONFIG_SYSTEM_WORKQUEUE_STACK_SIZE=2048
CONFIG_NET_TX_STACK_SIZE=2048
CONFIG_NET_RX_STACK_SIZE=5120
CONFIG_SHELL_STACK_SIZE=3072

CONFIG_NET_L2_OPENTHREAD=y

CONFIG_OPENTHREAD_DEBUG=y
CONFIG_OPENTHREAD_L2_DEBUG=y
CONFIG_OPENTHREAD_L2_LOG_LEVEL_INF=y
CONFIG_OPENTHREAD_CHANNEL=11

# Thread by default registers quite a lot addresses.
CONFIG_NET_IF_UNICAST_IPV6_ADDR_COUNT=6
CONFIG_NET_IF_MCAST_IPV6_ADDR_COUNT=8

# Other OpenThread dependencies
CONFIG_FLASH=y
CONFIG_FLASH_PAGE_LAYOUT=y
CONFIG_FLASH_MAP=y
CONFIG_MPU_ALLOW_FLASH_WRITE=y
CONFIG_NVS=y
CONFIG_SETTINGS=y

CONFIG_REBOOT=y

# nRF board library
CONFIG_DK_LIBRARY=y
```

## src/coap_client.c
```c
/*
 * Copyright (c) 2020 Nordic Semiconductor ASA
 *
 * SPDX-License-Identifier: LicenseRef-BSD-5-Clause-Nordic
 */
#include <zephyr.h>
#include <dk_buttons_and_leds.h>
#include <logging/log.h>
#include <net/socket.h>

#include <coap_server_client_interface.h>

#include "coap_utils.h"

LOG_MODULE_REGISTER(coap_client, CONFIG_COAP_CLIENT_LOG_LEVEL);

#define SLEEP_TIME 500
#define IPV6_ADDR_BYTE_LENGTH 16

/* Options supported by the server */
static const char *const light_option[] = { LIGHT_URI_PATH, NULL };
static const char *const provisioning_option[] = { PROVISIONING_URI_PATH,
						   NULL };

/* Thread multicast mesh local address */
static struct sockaddr_in6 multicast_local_addr = {
	.sin6_family = AF_INET6,
	.sin6_port = htons(COAP_PORT),
	.sin6_addr.s6_addr = { 0xff, 0x03, 0x00, 0x00, 0x00, 0x00, 0x00, 0x00,
			       0x00, 0x00, 0x00, 0x00, 0x00, 0x00, 0x00, 0x01 },
	.sin6_scope_id = 0U
};

/* Variable for storing server address acquiring in provisioning handshake */
static char unique_local_addr_str[INET6_ADDRSTRLEN];
static struct sockaddr_in6 unique_local_addr = { .sin6_family = AF_INET6,
						 .sin6_port = htons(COAP_PORT),
						 .sin6_addr.s6_addr = {0, },
						 .sin6_scope_id = 0U
}
;

static struct k_work unicast_light_work;
static struct k_work multicast_light_work;
static struct k_work provisioning_work;

static int on_provisioning_reply(const struct coap_packet *response,
				 struct coap_reply *reply,
				 const struct sockaddr *from)
{
	const u8_t *payload;
	u16_t payload_size = 0u;

	ARG_UNUSED(reply);
	ARG_UNUSED(from);

	payload = coap_packet_get_payload(response, &payload_size);

	if (payload_size != sizeof(unique_local_addr.sin6_addr)) {
		LOG_ERR("Received data size is invalid");
	}

	memcpy(&unique_local_addr.sin6_addr, payload, payload_size);

	if (!inet_ntop(AF_INET6, payload, unique_local_addr_str,
		       INET6_ADDRSTRLEN)) {
		LOG_ERR("Received data is not IPv6 address: %d", errno);
	}

	LOG_INF("Received peer address: %s", log_strdup(unique_local_addr_str));

	return errno;
}

static void toggle_one_light(struct k_work *item)
{
	u8_t payload = (u8_t)THREAD_COAP_UTILS_LIGHT_CMD_TOGGLE;

	ARG_UNUSED(item);

	if (unique_local_addr.sin6_addr.s6_addr16[0] == 0) {
		LOG_WRN("Peer address not set. Activate 'provisioning' option on the server side");
		return;
	}

	LOG_INF("Send 'light' request to: %s",
		log_strdup(unique_local_addr_str));
	coap_send_request(COAP_METHOD_PUT, &unique_local_addr, light_option,
			  &payload, sizeof(payload), NULL);
}

static void toggle_mesh_lights(struct k_work *item)
{
	static u8_t command = (u8_t)THREAD_COAP_UTILS_LIGHT_CMD_OFF;

	ARG_UNUSED(item);

	command = ((command == THREAD_COAP_UTILS_LIGHT_CMD_OFF) ?
			   THREAD_COAP_UTILS_LIGHT_CMD_ON :
			   THREAD_COAP_UTILS_LIGHT_CMD_OFF);

	LOG_INF("Send multicast mesh 'light' request");
	coap_send_request(COAP_METHOD_PUT, &multicast_local_addr, light_option,
			  &command, sizeof(command), NULL);
}

static void send_provisioning_request(struct k_work *item)
{
	ARG_UNUSED(item);

	LOG_INF("Send 'provisioning' request");
	coap_send_request(COAP_METHOD_GET, &multicast_local_addr,
			  provisioning_option, NULL, 0u, on_provisioning_reply);
}

static void on_button_changed(u32_t button_state, u32_t has_changed)
{
	u32_t buttons = button_state & has_changed;

	if (buttons & DK_BTN1_MSK) {
		k_work_submit(&unicast_light_work);
	}

	if (buttons & DK_BTN2_MSK) {
		k_work_submit(&multicast_light_work);
	}

	if (buttons & DK_BTN3_MSK) {
		k_work_submit(&provisioning_work);
	}
}

void main(void)
{
	int ret;

	LOG_INF("Start CoAP-client sample");

	k_work_init(&unicast_light_work, toggle_one_light);
	k_work_init(&multicast_light_work, toggle_mesh_lights);
	k_work_init(&provisioning_work, send_provisioning_request);

	ret = dk_buttons_init(on_button_changed);
	if (ret) {
		LOG_ERR("Cannot init buttons (error: %d)\n", ret);
		return;
	}

	coap_init();
}
```

## src/coap_utils.c
```c
#include <zephyr.h>
#include <errno.h>
#include <logging/log.h>
#include <net/coap.h>
#include <net/net_ip.h>
#include <net/net_mgmt.h>
#include <net/socket.h>
#include <net/udp.h>
#include <sys/byteorder.h>
#include <sys/printk.h>

#include "coap_utils.h"

LOG_MODULE_REGISTER(coap_utils, CONFIG_COAP_UTILS_LOG_LEVEL);

#define MAX_COAP_MSG_LEN 256
#define COAP_VER 1
#define COAP_TOKEN_LEN 8
#define COAP_MAX_REPLIES 1
#define COAP_POOL_SLEEP 500
#define COAP_OPEN_SOCKET_SLEEP 200
#define COAP_RECEIVE_STACK_SIZE 500

static K_THREAD_STACK_DEFINE(receive_stack_area, COAP_RECEIVE_STACK_SIZE);
static struct k_thread receive_thread_data;

const static int nfds = 1;
static struct pollfd fds;
static struct coap_reply replies[COAP_MAX_REPLIES];

static int coap_open_socket(void)
{
	int sock;

	while (1) {
		sock = socket(AF_INET6, SOCK_DGRAM, IPPROTO_UDP);
		if (sock < 0) {
			LOG_ERR("Failed to create UDP socket %d", errno);
			k_sleep(COAP_OPEN_SOCKET_SLEEP);
			continue;
		}
		break;
	}

	return sock;
}

static void coap_close_socket(int socket)
{
	(void)close(socket);
}

static void coap_receive(void)
{
	static u8_t buf[MAX_COAP_MSG_LEN + 1];

	struct coap_packet response;
	struct coap_reply *reply = NULL;
	static struct sockaddr from_addr;
	socklen_t from_addr_len;
	int len;
	int ret;

	while (1) {
		if (poll(&fds, nfds, K_FOREVER) < 0) {
			LOG_ERR("Error in poll:%d", errno);
			errno = 0;
			k_sleep(COAP_POOL_SLEEP);
			continue;
		}

		if (fds.revents & POLLERR) {
			LOG_ERR("Error in poll.. waiting a moment.");
			fds.revents = 0;
			k_sleep(COAP_POOL_SLEEP);
			continue;
		}

		if (fds.revents & POLLHUP) {
			LOG_ERR("Error in poll: POLLHUP");
			fds.revents = 0;
			continue;
		}

		if (fds.revents & POLLNVAL) {
			LOG_ERR("Error in poll: POLLNVAL - fd not open");
			fds.revents = 0;

			coap_close_socket(fds.fd);
			fds.fd = coap_open_socket();

			LOG_INF("Socket has been re-open");

			continue;
		}

		if (!(fds.revents & POLLIN)) {
			LOG_ERR("Unknown poll error");
			fds.revents = 0;
			continue;
		}

		fds.revents = 0;

		len = recvfrom(fds.fd, buf, sizeof(buf) - 1, 0, &from_addr,
			       &from_addr_len);

		if (len < 0) {
			LOG_ERR("Error reading response: %d", errno);
			errno = 0;
			continue;
		}

		if (len == 0) {
			LOG_ERR("Zero length recv");
			continue;
		}

		buf[len] = 0u;

		ret = coap_packet_parse(&response, buf, len, NULL, 0);
		if (ret < 0) {
			LOG_ERR("Invalid data received");
			continue;
		}

		reply = coap_response_received(&response, &from_addr, replies,
					       COAP_MAX_REPLIES);
		if (reply) {
			coap_reply_clear(reply);
		}
	}
}

static int coap_init_request(enum coap_method method,
			     enum coap_msgtype msg_type,
			     const char *const *uri_path_options, u8_t *payload,
			     u16_t payload_size, struct coap_packet *request,
			     u8_t *buf)
{
	const char *const *opt;
	int ret;

	ret = coap_packet_init(request, buf, MAX_COAP_MSG_LEN, COAP_VER,
			       msg_type, COAP_TOKEN_LEN, coap_next_token(),
			       method, coap_next_id());
	if (ret < 0) {
		LOG_ERR("Failed to init CoAP message");
		goto end;
	}

	for (opt = uri_path_options; opt && *opt; opt++) {
		ret = coap_packet_append_option(request, COAP_OPTION_URI_PATH,
						*opt, strlen(*opt));
		if (ret < 0) {
			LOG_ERR("Unable add option to request");
			goto end;
		}
	}

	if (payload) {
		ret = coap_packet_append_payload_marker(request);
		if (ret < 0) {
			LOG_ERR("Unable to append payload marker");
			goto end;
		}

		ret = coap_packet_append_payload(request, payload,
						 payload_size);
		if (ret < 0) {
			LOG_ERR("Not able to append payload");
			goto end;
		}
	}

end:
	return ret;
}

static int coap_send_message(const struct sockaddr_in6 *addr6,
			     struct coap_packet *request)
{
	return sendto(fds.fd, request->data, request->offset, 0,
		      (const struct sockaddr *)addr6, sizeof(*addr6));
}

static void coap_set_response_callback(struct coap_packet *request,
				       coap_reply_t reply_cb)
{
	struct coap_reply *reply;

	reply = &replies[0];

	coap_reply_clear(reply);
	coap_reply_init(reply, request);
	reply->reply = reply_cb;
}

void coap_init(void)
{
	fds.events = POLLIN;
	fds.revents = 0;
	fds.fd = coap_open_socket();

	/* start sock receive thread */
	k_thread_create(&receive_thread_data, receive_stack_area,
			K_THREAD_STACK_SIZEOF(receive_stack_area),
			(k_thread_entry_t)coap_receive, NULL, NULL, NULL,
			/* Lowest priority cooperative thread */
			K_PRIO_COOP(CONFIG_NUM_COOP_PRIORITIES - 1), 0,
			K_NO_WAIT);
	k_thread_name_set(&receive_thread_data, "CoAP-sock-recv");
	LOG_DBG("CoAP socket receive thread started");
}

int coap_send_request(enum coap_method method, const struct sockaddr_in6 *addr6,
		      const char *const *uri_path_options, u8_t *payload,
		      u16_t payload_size, coap_reply_t reply_cb)
{
	int ret;
	struct coap_packet request;
	u8_t buf[MAX_COAP_MSG_LEN];

	ret = coap_init_request(method, COAP_TYPE_NON_CON, uri_path_options,
				payload, payload_size, &request, buf);
	if (ret < 0) {
		goto end;
	}

	if (reply_cb != NULL) {
		coap_set_response_callback(&request, reply_cb);
	}

	ret = coap_send_message(addr6, &request);
	if (ret < 0) {
		LOG_ERR("Transmission failed: %d", errno);
		goto end;
	}

end:
	return ret;
}
```

## src/coap_utils.h
```c
#ifndef __COAP_UTILS_H__
#define __COAP_UTILS_H__

#include <net/coap.h>

void coap_init(void);

int coap_send_non_con_request(enum coap_method method, struct in6_addr *dst_addr,
			      const char *const *uri_path_option,
			      u8_t *payload, u16_t payload_size);

int coap_send_con_request(enum coap_method method, struct in6_addr *dst_addr,
			  const char *const *uri_path_options,
			  u8_t *payload, u16_t payload_size, coap_reply_t reply_cb);

#endif
```
