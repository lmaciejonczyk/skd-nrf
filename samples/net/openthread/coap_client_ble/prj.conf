## CMakeLists.txt
```
#
# Copyright (c) 2020 Nordic Semiconductor ASA
#
# SPDX-License-Identifier: LicenseRef-BSD-5-Clause-Nordic
#
cmake_minimum_required(VERSION 3.13.1)

set(NRF_SUPPORTED_BOARDS
	nrf52840_pca10056
	nrf52833_pca10100
)

include($ENV{ZEPHYR_BASE}/../nrf/cmake/boilerplate.cmake)
include($ENV{ZEPHYR_BASE}/cmake/app/boilerplate.cmake NO_POLICY_SCOPE)

project(openthread_ble_coap_client)

target_include_directories(app PRIVATE ../coap_interface ../coap_utils)

FILE(GLOB app_sources src/*.c ../coap_utils/*.c)
target_sources(app PRIVATE ${app_sources})
```

## Kconfig
```
#
# Copyright (c) 2020 Nordic Semiconductor ASA
#
# SPDX-License-Identifier: LicenseRef-BSD-5-Clause-Nordic
#

menu "Zephyr Kernel"
source "Kconfig.zephyr"
endmenu

module = COAP_CLIENT_BLE
module-str = CoAP client with NUS
source "${ZEPHYR_BASE}/subsys/logging/Kconfig.template.log_config"

module = BLE_UTILS
module-str = Bluetooth connection utilities
source "${ZEPHYR_BASE}/subsys/logging/Kconfig.template.log_config"

module = COAP_UTILS
module-str = CoAP connection utilities
source "${ZEPHYR_BASE}/subsys/logging/Kconfig.template.log_config"

module = COAP_CLIENT_UTILS
module-str = CoAP client utilities
source "${ZEPHYR_BASE}/subsys/logging/Kconfig.template.log_config"
```

## sample.yaml
```
sample:
  name: OpenThread BLE CoAP Client
  description: Test multiprotocol, OpenThread-BLE coexistance
tests:
  sample.net.openthread.coap_client_ble:
  tags: net openthread bluetooth mpsl coap
  platform_whitelist: nrf52840_pca10056 nrf52833_pca10100
```

## prj.conf
```kconfig
#
# Copyright (c) 2010 Nordic Semiconductor
#
# SPDX-License-Identifier: LicenseRef-BSD-5-Clause-Nordic
#
CONFIG_NCS_SAMPLES_DEFAULTS=y

# Enable Bluetooth
CONFIG_BT=y
CONFIG_BT_SMP=y
CONFIG_BT_PERIPHERAL=y
CONFIG_BT_DEVICE_NAME="NUS_CoAP_client"
CONFIG_BT_DEVICE_APPEARANCE=833
CONFIG_BT_MAX_CONN=1
CONFIG_BT_MAX_PAIRED=1

# Enable the NUS service
CONFIG_BT_GATT_NUS=y

# Enable bonding
CONFIG_BT_SETTINGS=y
CONFIG_FLASH=y
CONFIG_FLASH_PAGE_LAYOUT=y
CONFIG_FLASH_MAP=y
CONFIG_NVS=y
CONFIG_SETTINGS=y

# Generic networking options
CONFIG_NETWORKING=y
CONFIG_NET_UDP=y
CONFIG_NET_IPV6=y
CONFIG_NET_SOCKETS=y
CONFIG_NET_SOCKETS_POSIX_NAMES=y
CONFIG_NET_SOCKETS_POLL_MAX=4
CONFIG_NET_CONNECTION_MANAGER=y

# Kernel options
CONFIG_MAIN_STACK_SIZE=2048
CONFIG_ENTROPY_GENERATOR=y
CONFIG_INIT_STACKS=y

# Network buffers
CONFIG_NET_PKT_RX_COUNT=16
CONFIG_NET_PKT_TX_COUNT=16
CONFIG_NET_BUF_RX_COUNT=80
CONFIG_NET_BUF_TX_COUNT=80
CONFIG_NET_CONTEXT_NET_PKT_POOL=y

# IP address options
CONFIG_NET_MAX_CONTEXTS=10

# Network shell
CONFIG_NET_SHELL=y

# Enable C++
CONFIG_CPLUSPLUS=y

CONFIG_NET_CONFIG_SETTINGS=y
CONFIG_NET_IPV6_NBR_CACHE=n
CONFIG_NET_IPV6_MLD=n
CONFIG_NET_CONFIG_NEED_IPV6=y
CONFIG_NET_CONFIG_INIT_TIMEOUT=5

CONFIG_SYSTEM_WORKQUEUE_STACK_SIZE=2048
CONFIG_NET_TX_STACK_SIZE=2048
CONFIG_NET_RX_STACK_SIZE=5120
CONFIG_SHELL_STACK_SIZE=3072

CONFIG_NET_L2_OPENTHREAD=y

CONFIG_OPENTHREAD_DEBUG=y
CONFIG_OPENTHREAD_L2_DEBUG=y
CONFIG_OPENTHREAD_L2_LOG_LEVEL_INF=y
CONFIG_OPENTHREAD_CHANNEL=11


# Thread by default registers quite a lot addresses.
CONFIG_NET_IF_UNICAST_IPV6_ADDR_COUNT=6
CONFIG_NET_IF_MCAST_IPV6_ADDR_COUNT=8

# Other OpenThread dependencies
CONFIG_MPU_ALLOW_FLASH_WRITE=y
CONFIG_REBOOT=y

# nRF board library
CONFIG_DK_LIBRARY=y

# Enable CoAP protocol
CONFIG_COAP=y

# Logging
CONFIG_NET_LOG=y
CONFIG_LOG=y
CONFIG_NET_STATISTICS=y

# Application logging
CONFIG_COAP_CLIENT_BLE_LOG_LEVEL_DBG=y
CONFIG_COAP_CLIENT_UTILS_LOG_LEVEL_DBG=y
CONFIG_COAP_UTILS_LOG_LEVEL_DBG=y
CONFIG_BLE_UTILS_LOG_LEVEL_DBG=y

# Enable multiprotocol
CONFIG_BT_LL_NRFXLIB_DEFAULT=y
```

## src/ble_utils.c
```c
/*
 * Copyright (c) 2020 Nordic Semiconductor ASA
 *
 * SPDX-License-Identifier: LicenseRef-BSD-5-Clause-Nordic
 */
#include <zephyr.h>
#include <bluetooth/gatt.h>
#include <bluetooth/hci.h>
#include <bluetooth/uuid.h>
#include <logging/log.h>
#include <settings/settings.h>

#include "ble_utils.h"

LOG_MODULE_REGISTER(ble_utils, CONFIG_BLE_UTILS_LOG_LEVEL);

#define DEVICE_NAME CONFIG_BT_DEVICE_NAME
#define DEVICE_NAME_LEN (sizeof(DEVICE_NAME) - 1)

static struct bt_conn *current_conn;
ble_connection_cb_t on_connect;
ble_disconnection_cb_t on_disconnect;

static const struct bt_data ad[] = {
	BT_DATA_BYTES(BT_DATA_FLAGS, (BT_LE_AD_GENERAL | BT_LE_AD_NO_BREDR)),
	BT_DATA(BT_DATA_NAME_COMPLETE, DEVICE_NAME, DEVICE_NAME_LEN),
};

static const struct bt_data sd[] = {
	BT_DATA_BYTES(BT_DATA_UUID128_ALL, NUS_UUID_SERVICE),
};

static struct k_work on_connect_work;
static struct k_work on_disconnect_work;

static void connected(struct bt_conn *conn, u8_t err)
{
	if (err) {
		LOG_ERR("Connection failed (err %u)", err);
		return;
	}

	LOG_INF("Connected");
	current_conn = bt_conn_ref(conn);

	k_work_submit(&on_connect_work);
}

static void disconnected(struct bt_conn *conn, u8_t reason)
{
	LOG_INF("Disconnected (reason %u)", reason);

	if (current_conn) {
		bt_conn_unref(current_conn);
		current_conn = NULL;

		k_work_submit(&on_disconnect_work);
	}
}

static char *log_addr(struct bt_conn *conn)
{
	static char addr[BT_ADDR_LE_STR_LEN];

	bt_addr_le_to_str(bt_conn_get_dst(conn), addr, sizeof(addr));

	return log_strdup(addr);
}

static void __attribute__((unused))
security_changed(struct bt_conn *conn, bt_security_t level,
		 enum bt_security_err err)
{
	char *addr = log_addr(conn);

	if (!err) {
		LOG_INF("Security changed: %s level %u", addr, level);
	} else {
		LOG_INF("Security failed: %s level %u err %d", addr, level,
			err);
	}
}

static struct bt_conn_cb conn_callbacks = {
	.connected = connected,
	.disconnected = disconnected,
	COND_CODE_1(CONFIG_BT_SMP, (.security_changed = security_changed), ())
};

static void auth_passkey_display(struct bt_conn *conn, unsigned int passkey)
{
	LOG_INF("Passkey for %s: %06u", log_addr(conn), passkey);
}

static void auth_cancel(struct bt_conn *conn)
{
	LOG_INF("Pairing cancelled: %s", log_addr(conn));
}

static void pairing_confirm(struct bt_conn *conn)
{
	bt_conn_auth_pairing_confirm(conn);

	LOG_INF("Pairing confirmed: %s", log_addr(conn));
}

static void pairing_complete(struct bt_conn *conn, bool bonded)
{
	LOG_INF("Pairing completed: %s, bonded: %d", log_addr(conn), bonded);
}

static void pairing_failed(struct bt_conn *conn, enum bt_security_err reason)
{
	LOG_INF("Pairing failed conn: %s, reason %d", log_addr(conn), reason);
}

static struct bt_conn_auth_cb conn_auth_callbacks = {
	.passkey_display = auth_passkey_display,
	.cancel = auth_cancel,
	.pairing_confirm = pairing_confirm,
	.pairing_complete = pairing_complete,
	.pairing_failed = pairing_failed
};

static struct bt_gatt_nus_cb *set_nus_clbs(nus_received_cb_t on_nus_received,
					   nus_sent_cb_t on_nus_send)
{
	static struct bt_gatt_nus_cb nus_cb;

	nus_cb.received_cb = on_nus_received;
	nus_cb.sent_cb = on_nus_send;

	return &nus_cb;
}

int ble_utils_init(nus_received_cb_t on_nus_received, nus_sent_cb_t on_nus_send,
		   ble_connection_cb_t on_connect,
		   ble_disconnection_cb_t on_disconnect)
{
	int ret;
	struct bt_gatt_nus_cb *nus_clbs;

	k_work_init(&on_connect_work, on_connect);
	k_work_init(&on_disconnect_work, on_disconnect);

	bt_conn_cb_register(&conn_callbacks);

	if (IS_ENABLED(CONFIG_BT_SMP)) {
		bt_conn_auth_cb_register(&conn_auth_callbacks);
	}

	ret = bt_enable(NULL);
	if (ret) {
		LOG_ERR("Bluetooth initialization failed (error: %d)", ret);
		goto end;
	}

	LOG_INF("Bluetooth initialized");

	if (IS_ENABLED(CONFIG_SETTINGS)) {
		settings_load();
	}

	nus_clbs = set_nus_clbs(on_nus_received, on_nus_send);
	ret = bt_gatt_nus_init(nus_clbs);
	if (ret) {
		LOG_ERR("Failed to initialize UART service (error: %d)", ret);
		goto end;
	}

	ret = bt_le_adv_start(BT_LE_ADV_CONN, ad, ARRAY_SIZE(ad), sd,
			      ARRAY_SIZE(sd));
	if (ret) {
		LOG_ERR("Advertising failed to start (error: %d)", ret);
		goto end;
	}

end:
	return ret;
}
```

## src/ble_utils.h
```c
#ifndef __BLE_UTILS_H__
#define __BLE_UTILS_H__

#include <bluetooth/services/nus.h>

typedef void (*ble_connection_cb_t)(struct k_work *item);
typedef void (*ble_disconnection_cb_t)(struct k_work *item);

int ble_utils_init(nus_received_cb_t on_nus_received, nus_sent_cb_t on_nus_send,
		   ble_connection_cb_t on_connect,
		   ble_disconnection_cb_t on_disconnect);

#endif
```

## src/coap_client_ble.c
```c
/*
 * Copyright (c) 2020 Nordic Semiconductor ASA
 *
 * SPDX-License-Identifier: LicenseRef-BSD-5-Clause-Nordic
 */
#include <zephyr.h>
#include <coap_client_utils.h>
#include <dk_buttons_and_leds.h>
#include <logging/log.h>

#include "ble_utils.h"

LOG_MODULE_REGISTER(coap_client_ble, CONFIG_COAP_CLIENT_BLE_LOG_LEVEL);

#define COMMAND_REQUEST_UNICAST 'u'
#define COMMAND_REQUEST_MULTICAST 'm'
#define COMMAND_REQUEST_PROVISIONING 'p'

#define CON_STATUS_LED DK_LED2

#define RUN_STATUS_LED DK_LED1
#define RUN_LED_BLINK_INTERVAL 1000

static void on_nus_received(struct bt_conn *conn, const u8_t *const data,
			    u16_t len)
{
	LOG_INF("Received data: %s", log_strdup(data));

	if (len != 1) {
		LOG_WRN("Received invalid data length from NUS");
		return;
	}

	switch (*data) {
	case COMMAND_REQUEST_UNICAST:
		coap_client_toggle_one_light();
		break;

	case COMMAND_REQUEST_MULTICAST:
		coap_client_toggle_mesh_lights();
		break;

	case COMMAND_REQUEST_PROVISIONING:
		coap_client_send_provisioning_request();
		break;

	default:
		LOG_WRN("Received invalid data from NUS");
	}
}

static void on_button_changed(u32_t button_state, u32_t has_changed)
{
	u32_t buttons = button_state & has_changed;

	if (buttons & DK_BTN1_MSK) {
		coap_client_toggle_one_light();
	}

	if (buttons & DK_BTN2_MSK) {
		coap_client_toggle_mesh_lights();
	}

	if (buttons & DK_BTN3_MSK) {
		coap_client_send_provisioning_request();
	}
}

static void on_ble_connect(struct k_work *item)
{
	dk_set_led_on(CON_STATUS_LED);
}

static void on_ble_disconnect(struct k_work *item)
{
	dk_set_led_off(CON_STATUS_LED);
}

void main(void)
{
	int ret;
	int blink_status = 0;

	LOG_INF("Starting Multiprotocol: BLE - OT CoAP example");

	ret = dk_leds_init();
	if (ret) {
		LOG_ERR("Could not initialize leds (error: %d)", ret);
		goto error;
	}

	ret = dk_buttons_init(on_button_changed);
	if (ret) {
		LOG_ERR("Could not initialize buttons (error: %d)", ret);
		goto error;
	}

	ret = ble_utils_init(&on_nus_received, NULL, on_ble_connect,
			     on_ble_disconnect);
	if (ret) {
		LOG_ERR("ble_utils_init failed");
		goto error;
	}

	coap_client_utils_init();

	for (;;) {
		dk_set_led(RUN_STATUS_LED, (++blink_status) % 2);
		k_sleep(RUN_LED_BLINK_INTERVAL);
	}

error:
	dk_set_leds_state(DK_ALL_LEDS_MSK, DK_NO_LEDS_MSK);
}
```
