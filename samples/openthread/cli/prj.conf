## CMakeLists.txt
```
#
# Copyright (c) 2020 Nordic Semiconductor ASA
#
# SPDX-License-Identifier: LicenseRef-Nordic-5-Clause
#
cmake_minimum_required(VERSION 3.20.0)

find_package(Zephyr REQUIRED HINTS $ENV{ZEPHYR_BASE})

project(openthread_cli)

# NORDIC SDK APP START
target_sources(app PRIVATE src/main.c)
# NORDIC SDK APP END

target_sources_ifdef(CONFIG_BT app PRIVATE src/ble.c)

if (NOT CONFIG_RESET_ON_FATAL_ERROR)
  message(WARNING "installing proprietary fatal error handler")
#     target_link_libraries(app INTERFACE "-Wl,--wrap=z_fatal_error")
  # We need to wrap z_arm_fault() so we can get a copy
  # of the fault registers before Zephyr consumes and
  # clears the CFSR. See ports/zephyr/common/memfault_platform_core.c.
  zephyr_ld_options(-Wl,--wrap=z_arm_fault)
endif()
```

## Kconfig
```
#
# Copyright (c) 2020 Nordic Semiconductor ASA
#
# SPDX-License-Identifier: LicenseRef-Nordic-5-Clause
#

menu "Zephyr Kernel"
source "Kconfig.zephyr"
endmenu

module = OT_COMMAND_LINE_INTERFACE
module-str = ot_cli
source "${ZEPHYR_BASE}/subsys/logging/Kconfig.template.log_config"

config PPI_TRACE_PIN_START_TX
	int "Trace pin for start tx activity"
	default 3
	help
	  Pin is toggled when the transmission is started.


config PPI_TRACE_PIN_START_RX
	int "Trace pin for start rx activity"
	default 4
	help
	  Pin is toggled when the radio starts receiving.

config PPI_TRACE_PIN_END_RX_OR_TX
	int "Trace pin for end tx or rx activity"
	default 28
	help
	  Pin is toggled when a frame is received.


config PPI_TRACE_PIN_LAST_BIT_SEND_ON_THE_AIR
	int "Trace pin for last bit send on the air"
	default 29
	help
	  Pin is toggled when the last bit is sent on the air.
```

## sample.yaml
```
sample:
  name: OpenThread CLI sample
  description: Test OpenThread Command Line Interface.
tests:
  samples.openthread.cli:
    build_only: true
    platform_allow: nrf52840dk_nrf52840 nrf52833dk_nrf52833 nrf5340dk_nrf5340_cpuapp
    tags: ci_build
    integration_platforms:
      - nrf52840dk_nrf52840
      - nrf52833dk_nrf52833
      - nrf5340dk_nrf5340_cpuapp
  samples.openthread.cli.thread_1_2:
    build_only: true
    platform_allow: nrf52840dk_nrf52840 nrf52833dk_nrf52833
    tags: ci_build
    extra_args: OVERLAY_CONFIG=overlay-thread_1_2.conf
    integration_platforms:
      - nrf52840dk_nrf52840
      - nrf52833dk_nrf52833
  samples.openthread.cli.minimal_multiprotocol:
    build_only: true
    platform_allow: nrf52840dk_nrf52840 nrf52833dk_nrf52833 nrf5340dk_nrf5340_cpuapp
    tags: ci_build
    extra_args: OVERLAY_CONFIG=overlay-minimal_multiprotocol.conf
    integration_platforms:
      - nrf52840dk_nrf52840
      - nrf52833dk_nrf52833
      - nrf5340dk_nrf5340_cpuapp
  samples.openthread.cli.minimal_singleprotocol:
    build_only: true
    platform_allow: nrf52840dk_nrf52840 nrf52833dk_nrf52833 nrf5340dk_nrf5340_cpuapp
    tags: ci_build
    extra_args: OVERLAY_CONFIG=overlay-minimal_singleprotocol.conf
    integration_platforms:
      - nrf52840dk_nrf52840
      - nrf52833dk_nrf52833
      - nrf5340dk_nrf5340_cpuapp
  samples.openthread.cli.usb:
    build_only: true
    platform_allow: nrf5340dk_nrf5340_cpuapp nrf52840dk_nrf52840 nrf52840dongle_nrf52840 nrf52833dk_nrf52833
    tags: ci_build
    extra_args: OVERLAY_CONFIG=overlay-usb.conf
    integration_platforms:
      - nrf5340dk_nrf5340_cpuapp
      - nrf52840dk_nrf52840
      - nrf52840dongle_nrf52840
      - nrf52833dk_nrf52833
```

## prj.conf
```kconfig
#
# Copyright (c) 2020 Nordic Semiconductor
#
# SPDX-License-Identifier: LicenseRef-Nordic-5-Clause
#

# Network shell
CONFIG_SHELL=y
CONFIG_OPENTHREAD_SHELL=y
CONFIG_SHELL_ARGC_MAX=26
CONFIG_SHELL_CMD_BUFF_SIZE=416

# Enable OpenThread features set
CONFIG_OPENTHREAD_NORDIC_LIBRARY_MASTER=y

CONFIG_NET_L2_OPENTHREAD=y

# Generic networking options
CONFIG_NETWORKING=y

CONFIG_ASSERT=y
CONFIG_ASSERT_NO_COND_INFO=y
CONFIG_MBEDTLS_SHA1_C=n
CONFIG_FPU=y

CONFIG_GPIO_SHELL=y

# Enable Zephyr logging
CONFIG_LOG=y

# Use printk to log messages
CONFIG_LOG_MODE_MINIMAL=y

# Log only errors/hard faults
CONFIG_LOG_MAX_LEVEL=1

# nRF board library
CONFIG_DK_LIBRARY=y
```

## overlay-logging.conf
```kconfig
#
# Copyright (c) 2021 Nordic Semiconductor
#
# SPDX-License-Identifier: LicenseRef-Nordic-5-Clause

# Enable Zephyr logging
CONFIG_LOG=y

# Option for configuring log level in cli sample
CONFIG_OT_COMMAND_LINE_INTERFACE_LOG_LEVEL_INF=y

# Enable net module logging
CONFIG_NET_LOG=y
# Option for configuring log level in net config library
CONFIG_NET_CONFIG_LOG_LEVEL_WRN=y
# CONFIG_NET_CONFIG_LOG_LEVEL_INF=y

# Option for configuring log level in Zephyr l2 logging
CONFIG_OPENTHREAD_L2_DEBUG=y
CONFIG_OPENTHREAD_L2_LOG_LEVEL_WRN=y
# CONFIG_OPENTHREAD_L2_LOG_LEVEL_DBG=y
# CONFIG_OPENTHREAD_L2_DEBUG_DUMP_15_4=y
# CONFIG_OPENTHREAD_L2_DEBUG_DUMP_IPV6=y

# Enable OpenThread logging
CONFIG_OPENTHREAD_DEBUG=y
# Option for configuring log level in OpenThread
CONFIG_OPENTHREAD_LOG_LEVEL_INFO=y

# Adjust log strdup settings
CONFIG_LOG_STRDUP_BUF_COUNT=32
CONFIG_LOG_STRDUP_MAX_STRING=128
```

## overlay-minimal_multiprotocol.conf
```kconfig
#
# Copyright (c) 2020 Nordic Semiconductor
#
# SPDX-License-Identifier: LicenseRef-BSD-5-Clause-Nordic
#

# Build
CONFIG_SIZE_OPTIMIZATIONS=y

# Boot
CONFIG_BOOT_BANNER=n
CONFIG_BOOT_DELAY=0

# Disable asserts to save ~28kB ROM
CONFIG_ASSERT=n

# Disable logging to save ~11kB ROM
CONFIG_LOG=n
CONFIG_NET_LOG=n
CONFIG_NET_STATISTICS=n
CONFIG_OPENTHREAD_DEBUG=n
CONFIG_OPENTHREAD_L2_DEBUG=n

# Network shell
CONFIG_NET_SHELL=n

# Enable Bluetooth LE controller which supports multiprotocol
CONFIG_BT_LL_SOFTDEVICE_DEFAULT=y

# Enable and configure Bluetooth LE
CONFIG_BT=y
CONFIG_BT_PERIPHERAL=y
CONFIG_BT_DEVICE_NAME="NCS DUT"
CONFIG_BT_DEVICE_APPEARANCE=833

# Disable BT Security Manager Protocol support to save ~20kB ROM
# Pairing with the device will not be available, only non secure connection
CONFIG_BT_SMP=n

# Restrict number of BT connection
CONFIG_BT_MAX_CONN=1

# Disable Bluetooth features not needed
CONFIG_BT_DEBUG_NONE=y
CONFIG_BT_ASSERT=n
CONFIG_BT_DATA_LEN_UPDATE=n
CONFIG_BT_PHY_UPDATE=n
CONFIG_BT_GATT_CACHING=n
CONFIG_BT_GATT_SERVICE_CHANGED=n
CONFIG_BT_GAP_PERIPHERAL_PREF_PARAMS=n
CONFIG_BT_HCI_VS_EXT=n

# # Disable LE Controller-based Privacy
CONFIG_BT_CTLR_PRIVACY=n

# Disable HCI Vendor-Specific Extensions
CONFIG_BT_HCI_VS_EXT=n

# Reduce Bluetooth buffers
CONFIG_BT_DISCARDABLE_BUF_COUNT=1
CONFIG_BT_DISCARDABLE_BUF_SIZE=45
CONFIG_BT_RX_BUF_COUNT=2
CONFIG_BT_CONN_TX_MAX=2
CONFIG_BT_L2CAP_TX_BUF_COUNT=2
CONFIG_BT_ATT_TX_MAX=1
CONFIG_BT_CTLR_RX_BUFFERS=1
CONFIG_BT_CTLR_TX_BUFFERS=3
CONFIG_BT_CTLR_TX_BUFFER_SIZE=27

# In order to correctly tune the stack sizes for the threads the following
# Configurations can enabled to print the current use:
# CONFIG_THREAD_NAME=y
# CONFIG_THREAD_ANALYZER=y
# CONFIG_THREAD_ANALYZER_AUTO=y
# CONFIG_THREAD_ANALYZER_RUN_UNLOCKED=y
# CONFIG_THREAD_ANALYZER_USE_PRINTK=y
# CONFIG_CONSOLE=y
# CONFIG_UART_CONSOLE=y
# CONFIG_SERIAL=y
# CONFIG_PRINTK=y

# Example output of thread analyzer:
#  SDC RX              : unused 160 usage 200 / 360 (55 %)
#  BT RX               : unused 616 usage 408 / 1024 (39 %)
#  BT TX               : unused 304 usage 336 / 640 (52 %)
#  thread_analyzer     : unused 160 usage 352 / 512 (68 %)
#  conn_mgr_thread     : unused 136 usage 120 / 256 (46 %)
#  rx_workq            : unused 332 usage 180 / 512 (35 %)
#  openthread          : unused 1944 usage 2152 / 4096 (52 %)
#  workqueue           : unused 232 usage 280 / 512 (54 %)
#  tx_workq            : unused 136 usage 120 / 256 (46 %)
#  net_mgmt            : unused 104 usage 152 / 256 (59 %)
#  nrf5_rx             : unused 256 usage 256 / 512 (50 %)
#  sysworkq            : unused 792 usage 232 / 1024 (22 %)
#  MPSL signal         : unused 152 usage 488 / 640 (76 %)
#  shell_uart          : unused 648 usage 1400 / 2048 (68 %)
#  idle 00             : unused 56 usage 72 / 128 (56 %)

# Configurations set based on thread analyzer output.
CONFIG_SDC_RX_STACK_SIZE=360
CONFIG_BT_RX_STACK_SIZE=1024
CONFIG_BT_HCI_TX_STACK_SIZE_WITH_PROMPT=y
CONFIG_BT_HCI_TX_STACK_SIZE=640
CONFIG_OPENTHREAD_THREAD_STACK_SIZE=4096
CONFIG_NET_CONNECTION_MANAGER_STACK_SIZE=256
CONFIG_NET_RX_STACK_SIZE=512
CONFIG_NET_TX_STACK_SIZE=256
CONFIG_NET_MGMT_EVENT_STACK_SIZE=256
CONFIG_IEEE802154_NRF5_RX_STACK_SIZE=512
CONFIG_SYSTEM_WORKQUEUE_STACK_SIZE=1024
CONFIG_MPSL_SIGNAL_STACK_SIZE=640
CONFIG_SHELL_STACK_SIZE=2048
CONFIG_IDLE_STACK_SIZE=128
CONFIG_MAIN_STACK_SIZE=2048
CONFIG_ISR_STACK_SIZE=1024
```

## overlay-minimal_singleprotocol.conf
```kconfig
#
# Copyright (c) 2020 Nordic Semiconductor
#
# SPDX-License-Identifier: LicenseRef-BSD-5-Clause-Nordic
#

# Build
CONFIG_SIZE_OPTIMIZATIONS=y

# Boot
CONFIG_BOOT_BANNER=n
CONFIG_BOOT_DELAY=0

# Disable asserts to save ~28kB ROM
CONFIG_ASSERT=n

# Disable logging to save ~11kB ROM
CONFIG_LOG=n
CONFIG_NET_LOG=n
CONFIG_NET_STATISTICS=n
CONFIG_OPENTHREAD_DEBUG=n
CONFIG_OPENTHREAD_L2_DEBUG=n

# Network shell
CONFIG_NET_SHELL=n

# In order to correctly tune the stack sizes for the threads the following
# Configurations can enabled to print the current use:
# CONFIG_THREAD_NAME=y
# CONFIG_THREAD_ANALYZER=y
# CONFIG_THREAD_ANALYZER_AUTO=y
# CONFIG_THREAD_ANALYZER_RUN_UNLOCKED=y
# CONFIG_THREAD_ANALYZER_USE_PRINTK=y
# CONFIG_CONSOLE=y
# CONFIG_UART_CONSOLE=y
# CONFIG_SERIAL=y
# CONFIG_PRINTK=y

# Example output of thread analyzer:
#  thread_analyzer     : unused 160 usage 352 / 512 (68 %)
#  conn_mgr_thread     : unused 136 usage 120 / 256 (46 %)
#  rx_workq            : unused 332 usage 180 / 512 (35 %)
#  openthread          : unused 1944 usage 2152 / 4096 (52 %)
#  workqueue           : unused 232 usage 280 / 512 (54 %)
#  tx_workq            : unused 136 usage 120 / 256 (46 %)
#  net_mgmt            : unused 104 usage 152 / 256 (59 %)
#  nrf5_rx             : unused 256 usage 256 / 512 (50 %)
#  sysworkq            : unused 792 usage 232 / 1024 (22 %)
#  MPSL signal         : unused 152 usage 488 / 640 (76 %)
#  shell_uart          : unused 648 usage 1400 / 2048 (68 %)
#  idle 00             : unused 56 usage 72 / 128 (56 %)

# Configurations set based on thread analyzer output.
CONFIG_OPENTHREAD_THREAD_STACK_SIZE=4096
CONFIG_NET_CONNECTION_MANAGER_STACK_SIZE=256
CONFIG_NET_RX_STACK_SIZE=512
CONFIG_NET_TX_STACK_SIZE=256
CONFIG_NET_MGMT_EVENT_STACK_SIZE=256
CONFIG_IEEE802154_NRF5_RX_STACK_SIZE=512
CONFIG_SYSTEM_WORKQUEUE_STACK_SIZE=1024
CONFIG_MPSL_SIGNAL_STACK_SIZE=640
CONFIG_SHELL_STACK_SIZE=2048
CONFIG_IDLE_STACK_SIZE=128
CONFIG_MAIN_STACK_SIZE=2048
CONFIG_ISR_STACK_SIZE=1024
```

## overlay-thread_1_2.conf
```kconfig
#
# Copyright (c) 2020 Nordic Semiconductor
#
# SPDX-License-Identifier: LicenseRef-Nordic-5-Clause
#

# Configure dependencies
CONFIG_NRF_802154_ENCRYPTION=y
CONFIG_IEEE802154_2015=y
CONFIG_IEEE802154_CSL_ENDPOINT=y
CONFIG_NET_PKT_TXTIME=y
CONFIG_NET_PKT_TIMESTAMP=y
CONFIG_OPENTHREAD_MAC_SOFTWARE_TX_SECURITY_ENABLE=n

# Enable Thread 1.2 features
CONFIG_OPENTHREAD_THREAD_VERSION_1_2=y
CONFIG_OPENTHREAD_DUA=y
CONFIG_OPENTHREAD_MLR=y
CONFIG_OPENTHREAD_BACKBONE_ROUTER=y
CONFIG_OPENTHREAD_LINK_METRICS_INITIATOR=y
CONFIG_OPENTHREAD_LINK_METRICS_SUBJECT=y
CONFIG_OPENTHREAD_CSL_RECEIVER=y

# CSL configuration
CONFIG_OPENTHREAD_CSL_RECEIVE_TIME_AHEAD=3000
CONFIG_OPENTHREAD_CSL_MIN_RECEIVE_ON=5000

CONFIG_NRF_802154_SOURCE_INTERNAL=y
CONFIG_OPENTHREAD_CUSTOM_PARAMETERS="OPENTHREAD_CONFIG_PLATFORM_CSL_UNCERT=5"
CONFIG_PRINTK_SYNC=y

CONFIG_PPI_TRACE=y
```

## overlay-usb.conf
```kconfig
#
# Copyright (c) 2021 Nordic Semiconductor
#
# SPDX-License-Identifier: LicenseRef-Nordic-5-Clause
#

CONFIG_SHELL_BACKEND_SERIAL_INIT_PRIORITY=51

CONFIG_UART_LINE_CTRL=y
CONFIG_UART_SHELL_ON_DEV_NAME="CDC_ACM_0"

CONFIG_USB=y
CONFIG_USB_DEVICE_MANUFACTURER="Nordic Semiconductor ASA"
CONFIG_USB_DEVICE_PRODUCT="Thread Cli"
CONFIG_USB_DEVICE_VID=0x1915
CONFIG_USB_DEVICE_PID=0x0000
CONFIG_USB_UART_CONSOLE=y
```

## src/main.c
```c
/*
 * Copyright (c) 2020 Nordic Semiconductor ASA
 *
 * SPDX-License-Identifier: LicenseRef-Nordic-5-Clause
 */

#include <zephyr/kernel.h>
#include <zephyr/logging/log.h>

#include <dk_buttons_and_leds.h>

#if defined(CONFIG_BT)
#include "ble.h"
#endif

#include <nrfx.h>
#include <hal/nrf_power.h>
#if !NRF_POWER_HAS_RESETREAS
#include <hal/nrf_reset.h>
#endif

#include <zephyr/drivers/uart.h>
#include <zephyr/usb/usb_device.h>

LOG_MODULE_REGISTER(cli_sample, CONFIG_OT_COMMAND_LINE_INTERFACE_LOG_LEVEL);

#define WELLCOME_TEXT                                                                              \
	"\n\r"                                                                                     \
	"\n\r"                                                                                     \
	"OpenThread Command Line Interface is now running.\n\r"                                    \
	"Use the 'ot' keyword to invoke OpenThread commands e.g. "                                 \
	"'ot thread start.'\n\r"                                                                   \
	"For the full commands list refer to the OpenThread CLI "                                  \
	"documentation at:\n\r"                                                                    \
	"https://github.com/openthread/openthread/blob/master/src/cli/README.md\n\r"

/**
 * @brief  Helper function for printing the reason of the last reset.
 * Can be used to confirm that NCF field actually woke up the system.
 */
static void print_reset_reason(void)
{
	uint32_t reas;

#if NRF_POWER_HAS_RESETREAS

	reas = nrf_power_resetreas_get(NRF_POWER);
	nrf_power_resetreas_clear(NRF_POWER, reas);
	if (reas & NRF_POWER_RESETREAS_NFC_MASK) {
		LOG_ERR("Wake up by NFC field detect\n");
	} else if (reas & NRF_POWER_RESETREAS_RESETPIN_MASK) {
		LOG_ERR("Reset by pin-reset\n");
	} else if (reas & NRF_POWER_RESETREAS_SREQ_MASK) {
		LOG_ERR("Reset by soft-reset\n");
	} else if (reas) {
		LOG_ERR("Reset by a different source (0x%08X)\n", reas);
	} else {
		LOG_ERR("Power-on-reset\n");
	}

#else

	reas = nrf_reset_resetreas_get(NRF_RESET);
	nrf_reset_resetreas_clear(NRF_RESET, reas);
	if (reas & NRF_RESET_RESETREAS_NFC_MASK) {
		LOG_ERR("Wake up by NFC field detect\n");
	} else if (reas & NRF_RESET_RESETREAS_RESETPIN_MASK) {
		LOG_ERR("Reset by pin-reset\n");
	} else if (reas & NRF_RESET_RESETREAS_SREQ_MASK) {
		LOG_ERR("Reset by soft-reset\n");
	} else if (reas) {
		LOG_ERR("Reset by a different source (0x%08X)\n", reas);
	} else {
		LOG_ERR("Power-on-reset\n");
	}

#endif
}

void buggy_function(void)
{
	*(uint32_t *)0xbadcafe = 0x0;
}

static void on_button_changed(uint32_t button_state, uint32_t has_changed)
{
	uint32_t buttons = button_state & has_changed;

	if (buttons & DK_BTN1_MSK) {
		buggy_function();
	} else if (buttons & DK_BTN2_MSK) {
		__ASSERT(false, "typical assert");
	}
}

#if !defined(CONFIG_RESET_ON_FATAL_ERROR)
// Zephy's z_arm_fault() function consumes and clears
// the SCB->CFSR register so we must wrap their function
// so we can preserve the pristine fault register values.
void __wrap_z_arm_fault(uint32_t msp, uint32_t psp, uint32_t exc_return,
			_callee_saved_t *callee_regs)
{
	arch_irq_lock();

	while (1) {
		__ASM("nop");
	}
}
#endif

void main(void)
{
#if DT_NODE_HAS_COMPAT(DT_CHOSEN(zephyr_shell_uart), zephyr_cdc_acm_uart)
	int ret;
	const struct device *dev;
	uint32_t dtr = 0U;

	ret = usb_enable(NULL);
	if (ret != 0) {
		LOG_ERR("Failed to enable USB");
		return;
	}

	dev = DEVICE_DT_GET(DT_CHOSEN(zephyr_shell_uart));
	if (dev == NULL) {
		LOG_ERR("Failed to find specific UART device");
		return;
	}

	LOG_INF("Waiting for host to be ready to communicate");

	/* Data Terminal Ready - check if host is ready to communicate */
	while (!dtr) {
		ret = uart_line_ctrl_get(dev, UART_LINE_CTRL_DTR, &dtr);
		if (ret) {
			LOG_ERR("Failed to get Data Terminal Ready line state: %d", ret);
			continue;
		}
		k_msleep(100);
	}

	/* Data Carrier Detect Modem - mark connection as established */
	(void)uart_line_ctrl_set(dev, UART_LINE_CTRL_DCD, 1);
	/* Data Set Ready - the NCP SoC is ready to communicate */
	(void)uart_line_ctrl_set(dev, UART_LINE_CTRL_DSR, 1);
#endif

	print_reset_reason();

	int ret = dk_buttons_init(on_button_changed);
	if (ret) {
		LOG_ERR("Cannot init buttons (error: %d)", ret);
		return;
	}

#if CONFIG_BT
	ble_enable();
#endif
}
```
